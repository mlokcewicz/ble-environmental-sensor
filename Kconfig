## Kconfig
```kconfig
source "Kconfig.zephyr"

config CONNECTABLE_ADV_INTERVAL_MIN
	int "Connectable advertising interval minimum"
	default 160
    help
      This option sets the minimum advertising interval for connectable advertising. The value is specified in units of 0.625 ms, so a value of 160 corresponds to an interval of 100 ms. Setting this value allows you to control how frequently the device advertises when it is in a connectable state, which can impact power consumption and responsiveness to connection requests.

config CONNECTABLE_ADV_INTERVAL_MAX
	int "Connectable advertising interval maximum"
	default 240  
    help
      This option sets the maximum advertising interval for connectable advertising. The value is specified in units of 0.625 ms, so a value of 240 corresponds to an interval of 150 ms. Setting this value allows you to control how frequently the device advertises when it is in a connectable state, which can impact power consumption and responsiveness to connection requests.
```

## boards/awesometronics/env_sens_board/Kconfig.env_sens_board
```kconfig
# Copyright (c) 2021 Nordic Semiconductor ASA
# SPDX-License-Identifier: Apache-2.0

config BOARD_ENV_SENS_BOARD
	bool "Environmental Sensor Board"
	help
	  This is the configuration for the Environmental Sensor Board from Awesometronics.
	select SOC_NRF52832_QFAA
```

## boards/awesometronics/env_sens_board/board.yml
```yaml
# Copyright (c) 2024 Nordic Semiconductor ASA
# SPDX-License-Identifier: Apache-2.0

board:
  name: env_sens_board
  vendor: awesometronics
  socs:
    - name: nrf52832
  revision:
    format: major.minor.patch
    default: 1.0.0
    exact: true
    revisions:
    - name: 1.0.0
```
