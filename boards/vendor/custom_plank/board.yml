## boards/vendor/custom_plank/board.yml
```yaml
# Copyright (c) 2024 Nordic Semiconductor ASA
# SPDX-License-Identifier: Apache-2.0

board:
  name: custom_plank
  vendor: vendor
  socs:
    - name: nrf52832
  revision:
    format: major.minor.patch
    default: 1.0.0
    exact: true
    revisions:
    - name: 1.0.0
```
